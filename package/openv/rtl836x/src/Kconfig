## package/openv/rtl836x/src/Kconfig
```kconfig
config RTL836x
    tristate "driver for rtl836x"
    help
    This is a driver for rtl 836x switch 
    If unsure, say N.
```

## target/linux/sunxid1/image/Config.in
```kconfig
config SUNXID1_SD_BOOT_PARTSIZE
	int "Boot (SD Card) filesystem partition size (in MB)"
	depends on TARGET_sunxid1
	default 32
```
